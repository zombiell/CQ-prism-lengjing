#include "chassis.h"
#include <math.h>

/* ============================================================
 * 四轮降额总开关 —— 已【停用】，保留代码备用
 *
 * 【历史】
 *   曾经怀疑"斜行(2轮)能走、直行(4轮)不动"是电源带不动，
 *   所以设成 0.50 把四轮输出减半。
 *
 * 【实测结论（2026-10-15）】
 *   改成 0.50 后现象【没有改善】，只是起步多了一点延迟 ——
 *   说明主要矛盾不是电流预算。而且【架空时轮子也完全不转】，
 *   直接排除了电源和机械打架两种可能。
 *
 *   所以现在把它设回 1.00 = 等于关闭降额，恢复原始行为。
 *   真正的病因还在查（怀疑某个 PWM 通道根本没输出）。
 *
 * 【如果以后确认是电源问题，再把这个值改回 0.50 即可】
 *     1.00 → 不减（当前）
 *     0.67 → 四轮 duty 0.40
 *     0.50 → 四轮 duty 0.30（负荷与 2 轮斜行相同）
 * ============================================================ */
#define CHASSIS_FOUR_WHEEL_SCALE   1.00f

/* 判断"某个轮子是否在出力"的阈值。
 * 麦轮某些动作会有轮子正好等于 0（比如斜行只有 2 个轮子转），
 * 用一个小阈值把它们排除掉，避免误判成 4 轮动作。
 */
#define CHASSIS_WHEEL_ACTIVE_EPS   0.01f

/* ============================================================
 * 四个轮子的方向标定符号，只能是 +1 或 -1
 *
 * 什么时候需要改这里？
 *   - 电机线接反了但懒得拆线 → 把该轮改成 -1
 *   - 麦轮辊子装反了         → 把该轮改成 -1
 *
 * 建议先用 chassis_wheel_test() 逐个验证，确认物理接线都正确
 * 再回来处理麦轮方向问题
 * ============================================================ */
static int8_t sgn[MOTOR_COUNT] = { +1, +1, +1, +1 };

void chassis_set_sign(int8_t s_fl, int8_t s_fr, int8_t s_rl, int8_t s_rr)
{
    sgn[MOTOR_FL] = (s_fl >= 0) ? +1 : -1;
    sgn[MOTOR_FR] = (s_fr >= 0) ? +1 : -1;
    sgn[MOTOR_RL] = (s_rl >= 0) ? +1 : -1;
    sgn[MOTOR_RR] = (s_rr >= 0) ? +1 : -1;
}

/* ============================================================
 * 麦轮逆运动学
 *
 * 标准 X 形布局（辊子从车顶看呈 X）：
 *
 *        前
 *   FL ╱     ╲ FR        左轮的辊子：╱
 *      ╲     ╱           右轮的辊子：╲
 *   RL       RR
 *        后
 *
 * 逆解公式：
 *   前左 = vx + vy + w
 *   前右 = vx - vy - w
 *   后左 = vx - vy + w
 *   后右 = vx + vy - w
 * ============================================================ */
void chassis_mecanum(float vx, float vy, float w)
{
    float d[MOTOR_COUNT];

    /* ---------- 1. 逆运动学分解 ---------- */
    d[MOTOR_FL] = vx + vy + w;
    d[MOTOR_FR] = vx - vy - w;
    d[MOTOR_RL] = vx - vy + w;
    d[MOTOR_RR] = vx + vy - w;

    /* ---------- 2. 归一化 ----------
     * 找出四个值里绝对值最大的那个
     * 如果超过 1.0，就整体等比例缩小
     * 这样能保证合成动作的方向正确，不会因为某一路超限而变形
     */
    float peak = 0.0f;
    for (uint8_t i = 0; i < MOTOR_COUNT; i++) {
        float a = fabsf(d[i]);
        if (a > peak) {
            peak = a;
        }
    }

    if (peak > 1.0f) {
        for (uint8_t i = 0; i < MOTOR_COUNT; i++) {
            d[i] /= peak;
        }
    }

    /* ---------- 3. 方向标定 ----------
     * 把 sgn[] 提前乘进来，方便后面判断"到底有几个轮子真的在出力"。
     * 如果某个轮子的线接反了（sgn = -1），这一步之后它的值就是反的，
     * 后面数出来的 active 数量才是真实的。
     */
    for (uint8_t i = 0; i < MOTOR_COUNT; i++) {
        d[i] *= (float)sgn[i];
    }

    /* ---------- 4. 四轮降额（省电）----------
     * 先数一数有几个轮子要出力：
     *   2 个 → 斜行 / 边走边转
     *   4 个 → 直行 / 横移 / 原地自转
     *
     * ⚠️ 注意：CHASSIS_FOUR_WHEEL_SCALE 现在设成 1.00 = 已关闭。
     *    因为实测证明"降额"对当初的问题毫无帮助（真正原因是马达死区）。
     *    代码保留着，万一以后确认是电源问题可以改回 0.50。
     */
    uint8_t active = 0;
    for (uint8_t i = 0; i < MOTOR_COUNT; i++) {
        if (fabsf(d[i]) > CHASSIS_WHEEL_ACTIVE_EPS) {
            active++;
        }
    }

    float scale = 1.0f;
    if (active == MOTOR_COUNT) {
        scale = CHASSIS_FOUR_WHEEL_SCALE;
    }

    /* ---------- 5. 输出到电机 ----------
     * 这里用 motor_set_ramp 而不是 motor_set：
     *   motor_set      = 立刻到位
     *   motor_set_ramp = 分小步逼近，削平启动电流尖峰
     *
     * ⚠️ 因为斜坡是"每次调用走一小步"，所以本函数必须在固定周期里调用。
     *    main.c 里正好是每 CTRL_PERIOD_MS(10ms) 调一次，节奏是匹配的。
     *    如果以后改了控制周期，记得同步调整 MOTOR_RAMP_UP。
     *
     * ★ 注意：真正的"马达死区补偿"在 motor.c 的 motor_set_ramp 里做，
     *         不在这一层。所以这里传出去的还是原始 duty 比例。
     */
    for (uint8_t i = 0; i < MOTOR_COUNT; i++) {
        motor_set_ramp((motor_id_t)i, d[i] * scale);
    }
}

/* ============================================================
 * 全部停止
 *
 * 这里是急停路径，要"立刻停"，不能走斜坡慢慢减速，
 * 所以先 motor_ramp_reset() 清掉斜坡状态，再真正切断输出。
 * （motor_coast_all 内部也会 reset 一次，这里显式写出来是为了表明意图）
 * ============================================================ */
void chassis_stop(void)
{
    motor_ramp_reset();
    motor_coast_all();
}

/* ============================================================
 * 单轮测试（调试用）
 * ============================================================ */
void chassis_wheel_test(motor_id_t id, float duty)
{
    motor_coast_all();
    motor_set(id, duty);
}
